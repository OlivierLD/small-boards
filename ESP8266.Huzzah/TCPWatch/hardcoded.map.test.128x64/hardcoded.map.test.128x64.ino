/**
   Hard coded map test.
   Draw a map on a SSD1306 128x64

   @author Olivier LeDiouris

   Keywords: SSD1306, Dynamic Arrays, Kewl Stuff!
*/
// Graphical primitives doc at https://learn.adafruit.com/adafruit-gfx-graphics-library/graphics-primitives
#include <Adafruit_GFX.h>
#include <Adafruit_SSD1306.h>

#define ROT_0   0
#define ROT_90  1
#define ROT_180 2
#define ROT_270 3

#define NULL 0
// #define DEBUG // Uncomment for more Serial output.

#define POS_LIST_MAX_LENGTH 200

typedef struct POS {
  struct POS * next;
  float lat;
  float lng;
} Pos;

/* Chain Lists Utils */
typedef struct SMALL {
  struct SMALL * next;
} StrPt;

void chainAppend (StrPt * head, StrPt * pt) {
  StrPt * structPt = head;

  while (structPt->next) {
    structPt = structPt->next;
  }
  structPt->next = pt;
}

void freeChain (StrPt * head) {
  StrPt * nextOne;
  StrPt * thisOne;

  thisOne = head;
  while (thisOne) {
    nextOne = thisOne->next;
    free((char *)thisOne);
    thisOne = nextOne;
  }
}

#define walkList(a,b) for (b=a;b;b=b->next)

void chainRemove (StrPt * head, StrPt * pt) {
  StrPt * locPt;
  walkList(head, locPt) {
    if (locPt->next == pt) {
      locPt->next = pt->next;
      break;
    }
  }
}

StrPt * dropHead (StrPt * head) {
  if (head != NULL) {
    if (head->next != NULL) {
      StrPt * newHead = head->next;
      free((char*)head);
      return newHead;
    }
  }
  return NULL;
}

int listLength(StrPt * head) {
  int len = 0;
  StrPt * locPt;
  walkList(head, locPt) {
    len += 1;
  }
  return len;
}

float positions[][2] = {
  { -9.107533, -140.208600 },
  { -9.107583, -140.208650 },
  { -9.107583, -140.208650 },
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  { -9.116133, -140.216633 }
};

const int NB_POS = 302;
int posIndex = 0;

const int BETWEEN_LOOPS = 500; // in milli-sec.

const int SSD1306_WIDTH = 128;
const int SSD1306_HEIGHT = 64;
const int SSD1306_I2C_ADDR = 0x3D; // for 128x64

Adafruit_SSD1306 ssd1306 = Adafruit_SSD1306(SSD1306_WIDTH, SSD1306_HEIGHT, &Wire);

float prevLat = -1000,
      prevLng = -1000;

Pos * posListHead = NULL;

int screenIndex = -1;

void repaint() {
  ssd1306.clearDisplay();

  ssd1306.setTextColor(WHITE);
  ssd1306.setTextSize(1);

  char dataBuffer[128];

  // Draw a map
  ssd1306.drawRect(0, 0, ssd1306.width(), ssd1306.height(), WHITE);
  // Draw data here.
  if (posListHead != NULL) {
    // 1 - Obtain boundaries
    float minLat = 1000, maxLat = -1000, minLng = 1000, maxLng = -1000;
    Pos * it;
    walkList(posListHead, it) {
      minLat = min(it->lat, minLat);
      maxLat = max(it->lat, maxLat);
      minLng = min(it->lng, minLng);
      maxLng = max(it->lng, maxLng);
    }
    // 2 - Now plot
    float deltaLat = maxLat - minLat;
    float deltaLng = maxLng - minLng;
#ifdef DEBUG
    sprintf(dataBuffer, "lat in [%f..%f], lng in [%f..%f]", minLat, maxLat, minLng, maxLng);
    Serial.println(dataBuffer);
#endif
    float distCoeff = min( ((float)ssd1306.width()) / deltaLng, ((float)ssd1306.height()) / deltaLat) * 0.8; // 0.8, not to hit the borders
    // Square projection for now...
    int prevX = -1, prevY = -1;
    walkList(posListHead, it) {
      float graphLng = it->lng - minLng;
      float fromCenterLng = graphLng - (deltaLng / 2);
      int x = round(((float)ssd1306.width() / 2) + (fromCenterLng * distCoeff));
      float graphLat = it->lat - minLat;
      float fromCenterLat = graphLat - (deltaLat / 2);
      int y = round(((float)ssd1306.height() / 2) - (fromCenterLat * distCoeff));
      if (prevX == -1 && prevY == -1) {
        ssd1306.drawPixel(x, y, WHITE);
      } else {
        ssd1306.drawLine(prevX, prevY, x, y, WHITE);
      }
      prevX = x;
      prevY = y;
    }
    // Plot last point
    if (prevX != -1 && prevY != -1) {
      ssd1306.fillCircle(prevX, prevY, 2, WHITE);
    }
  }

  ssd1306.setCursor(0, 0);
  ssd1306.display();
}

void setup() {
  ssd1306.begin(SSD1306_SWITCHCAPVCC, SSD1306_I2C_ADDR);
  // initialize display
  ssd1306.setRotation(ROT_90);
  ssd1306.display();
  delay(1000);
  ssd1306.clearDisplay();
  ssd1306.display();

  Serial.begin(115200); // Console output
  delay(100);

  int count = 0;
  char dataBuffer[128];

  // A banner
  ssd1306.setTextSize(2);
  ssd1306.setTextWrap(true);
  ssd1306.setTextColor(WHITE);
  ssd1306.setCursor(0, 0);
  ssd1306.println("TCP");
  ssd1306.println("Watch");
  ssd1306.setTextSize(1);
  ssd1306.println("by OlivSoft");
  ssd1306.setCursor(0, 0);
  ssd1306.display(); // actually display all of the above

  delay(1000); // Wait, to read the banner
}

unsigned long lastDisplay = 0;

void loop() {
  unsigned long time = millis();
  if (time - lastDisplay > BETWEEN_LOOPS) {

    // Read new pos
    float lat = 0, lng = 0;

    if (posIndex < NB_POS) {
      float * pos = positions[posIndex];
      lat = pos[0];
      lng = pos[1];
      posIndex += 1;
    }

    char dataBuffer[128];
    if (lat != 0 && lng != 0) {
      sprintf(dataBuffer, "LAT=%f, LNG=%f", lat, lng);
    } else {
      sprintf(dataBuffer, "Data exhausted");
    }
    Serial.println(dataBuffer);

    // New position? (for the map)
    if (lat != 0 || lng != 0) {
      if (posListHead == NULL) {
        posListHead = (Pos *) calloc(1, sizeof(Pos));
        posListHead->next = NULL;
        posListHead->lat = lat;
        posListHead->lng = lng;
      } else {
        Pos * newPos = (Pos *) calloc(1, sizeof(Pos));
        newPos->next = NULL;
        newPos->lat = lat;
        newPos->lng = lng;
        chainAppend((StrPt *)posListHead, (StrPt *)newPos);
      }
      prevLat = lat;
      prevLng = lng;
      // Trim list if needed
      while (listLength((StrPt *)posListHead) > POS_LIST_MAX_LENGTH) {
        posListHead = (Pos *)dropHead((StrPt *)posListHead);
      }
    }
    lastDisplay = millis();
  }
  repaint(); // Display data on screen
}

